AUTOSAR XML (schema 4.0)
package /Swcs
  application sw component type SWC_Torque
    behavior IB_Torque
      timing event TE_TqTask: start-on-event=RE_TqTask, period=0.01
      timing event TE_OutTask: start-on-event=RE_OutTask, period=0.01
      runnable RE_TqTask: symbol=Tq_Task
        data-receive-point-by-arguments:
          access RP_TqReq: accessed-variable=TqReq.Value
      runnable RE_OutTask: symbol=Out_Task
        data-send-points:
          access SP_TqCmd: accessed-variable=TqCmd.Value
